#include "lcd_9488_drv.h"
#include "delay.h"
#include "stdio.h"

//////////////////////////////////////////////////////////////////////////////////
// TFT液晶驱动
// 正点原子@ALIENTEK
// modified by tyj
//////////////////////////////////////////////////////////////////////////////////

static const unsigned char asc2_1608[95][16] = {
{0x00,0x00,0x00,0x00,0x00,0x00,0x00,0x00,0x00,0x00,0x00,0x00,0x00,0x00,0x00,0x00},/*" ",0*/
{0x00,0x00,0x00,0x00,0x00,0x00,0x1F,0xCC,0x00,0x0C,0x00,0x00,0x00,0x00,0x00,0x00},/*"!",1*/
{0x00,0x00,0x08,0x00,0x30,0x00,0x60,0x00,0x08,0x00,0x30,0x00,0x60,0x00,0x00,0x00},/*""",2*/
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{0x00,0x00,0x60,0x00,0x80,0x00,0x80,0x00,0x40,0x00,0x40,0x00,0x20,0x00,0x20,0x00},/*"~",94*/
};

//LCD的画笔颜色和背景色
uint32_t POINT_COLOR = 0xFF000000; //画笔颜色
uint32_t BACK_COLOR = 0xFFFFFFFF; //背景色


//设置LCD的自动扫描方向(对RGB屏无效)
//注意:其他函数可能会受到此函数设置的影响(尤其是9341),
//所以,一般设置为L2R_U2D即可,如果设置为其他扫描方式,可能导致显示不正常.
//dir:0~7,代表8个方向(具体定义见lcd.h)
//9341/5310/5510/1963等IC已经实际测试
void LCD_Scan_Dir(uint8_t dir)
{
    // MSB-LSB B-G-R
    uint16_t regval = 0X08;

    switch (dir)
    {
    case L2R_U2D://从左到右,从上到下
        regval |= (0 << 7) | (0 << 6) | (0 << 5);
        break;
    case L2R_D2U://从左到右,从下到上
        regval |= (1 << 7) | (0 << 6) | (0 << 5);
        break;
    case R2L_U2D://从右到左,从上到下
        regval |= (0 << 7) | (1 << 6) | (0 << 5);
        break;
    case R2L_D2U://从右到左,从下到上
        regval |= (1 << 7) | (1 << 6) | (0 << 5);
        break;
    case U2D_L2R://从上到下,从左到右
        regval |= (0 << 7) | (0 << 6) | (1 << 5);
        break;
    case U2D_R2L://从上到下,从右到左
        regval |= (0 << 7) | (1 << 6) | (1 << 5);
        break;
    case D2U_L2R://从下到上,从左到右
        regval |= (1 << 7) | (0 << 6) | (1 << 5);
        break;
    case D2U_R2L://从下到上,从右到左
        regval |= (1 << 7) | (1 << 6) | (1 << 5);
        break;
    }
    /* Set Memory Access Control (36h)  */
    LCD_WR_REG(0X36);
    LCD_WR_DATA(regval);

    LCD_Set_Window(0, 0, LCD_W - 1, LCD_H - 1);
}

//快速画点
//x,y:坐标
//color:颜色
void LCD_DrawPoint_color(uint16_t x, uint16_t y, uint32_t color)
{
    LCD_Set_Window(x, y, LCD_W - 1, LCD_H - 1);
    LCD_WriteRAM_Prepare();	//开始写入GRAM
    AHB_LCD->data_reg = color;
}

//设置窗口(对RGB屏无效),并自动设置画点坐标到窗口左上角(sx,sy).
//sx,sy:窗口起始坐标(左上角)
//width,height:窗口宽度和高度,必须大于0!!
//窗体大小:width*height. 
void LCD_Set_Window(uint16_t sx, uint16_t sy, uint16_t ex, uint16_t ey)
{
    LCD_WR_REG(SETX_CMD);
    LCD_WR_DATA(sx >> 8);
    LCD_WR_DATA(sx & 0XFF);
    LCD_WR_DATA(ex >> 8);
    LCD_WR_DATA(ex & 0XFF);
    LCD_WR_REG(SETY_CMD);
    LCD_WR_DATA(sy >> 8);
    LCD_WR_DATA(sy & 0XFF);
    LCD_WR_DATA(ey >> 8);
    LCD_WR_DATA(ey & 0XFF);
}

//初始化lcd
//该初始化函数可以初始化各种型号的LCD(详见本.c文件最前面的描述)
void LCD_Init(void)
{
    // 初始化GPIO
    GPIO_ResetBit(STAR_GPIO0, GPIO_Pin_17);
    delay_ms(10);
    GPIO_SetBit(STAR_GPIO0, GPIO_Pin_17);
    delay_ms(10);

    AHB_LCD->tick_cmd_data_chg = 1;
    AHB_LCD->tick_write_l = 2;
    AHB_LCD->tick_write_h = 2;
    AHB_LCD->tick_read_l = 36;
    AHB_LCD->tick_read_h = 10;
    AHB_LCD->ctrl = 1;

    //尝试9488 ID的读取
    LCD_WR_REG(0XD3);
    uint16_t ID = LCD_RD_DATA(); //dummy read
    ID = LCD_RD_DATA(); //读到0X00
    ID = LCD_RD_DATA(); //读取93或者94
    ID <<= 8;
    ID |= LCD_RD_DATA(); //读取41或者88
    printf(" LCD ID:%x\r\n", ID); //打印LCD ID

    LCD_WR_REG(0XF7);
    LCD_WR_DATA(0xA9);
    LCD_WR_DATA(0x51);
    LCD_WR_DATA(0x2C);
    LCD_WR_DATA(0x82);

    /* Power Control 1 (C0h)  */
    LCD_WR_REG(0xC0);
    LCD_WR_DATA(0x11);
    LCD_WR_DATA(0x09);

    /* Power Control 2 (C1h) */
    LCD_WR_REG(0xC1);
    LCD_WR_DATA(0x41);

    /* VCOM Control (C5h)  */
    LCD_WR_REG(0XC5);
    LCD_WR_DATA(0x00);
    LCD_WR_DATA(0x0A);
    LCD_WR_DATA(0x80);

    /* Frame Rate Control (In Normal Mode/Full Colors) (B1h) */
    LCD_WR_REG(0xB1);
    LCD_WR_DATA(0xB0);
    LCD_WR_DATA(0x11);

    /* Display Inversion Control (B4h) */
    LCD_WR_REG(0xB4);
    LCD_WR_DATA(0x02);

    /* Display Function Control (B6h)  */
    LCD_WR_REG(0xB6);
    LCD_WR_DATA(0x02);
    LCD_WR_DATA(0x22);

    /* Entry Mode Set (B7h)  */
    LCD_WR_REG(0xB7);
    LCD_WR_DATA(0xc6);

    /* HS Lanes Control (BEh) */
    LCD_WR_REG(0xBE);
    LCD_WR_DATA(0x00);
    LCD_WR_DATA(0x04);

    /* Set Image Function (E9h)  */
    LCD_WR_REG(0xE9);
    LCD_WR_DATA(0x00);

    /* Set Memory Access Control (36h)  */
    LCD_WR_REG(0x36);
    LCD_WR_DATA(0x08);

    /* Interface Pixel Format (3Ah) */
    LCD_WR_REG(0x3A);
    LCD_WR_DATA(0x55); /* 0x55 : 16 bits/pixel  */

    /* PGAMCTRL (Positive Gamma Control) (E0h) */
    LCD_WR_REG(0xE0);
    LCD_WR_DATA(0x00);
    LCD_WR_DATA(0x07);
    LCD_WR_DATA(0x10);
    LCD_WR_DATA(0x09);
    LCD_WR_DATA(0x17);
    LCD_WR_DATA(0x0B);
    LCD_WR_DATA(0x41);
    LCD_WR_DATA(0x89);
    LCD_WR_DATA(0x4B);
    LCD_WR_DATA(0x0A);
    LCD_WR_DATA(0x0C);
    LCD_WR_DATA(0x0E);
    LCD_WR_DATA(0x18);
    LCD_WR_DATA(0x1B);
    LCD_WR_DATA(0x0F);

    /* NGAMCTRL (Negative Gamma Control) (E1h)  */
    LCD_WR_REG(0XE1);
    LCD_WR_DATA(0x00);
    LCD_WR_DATA(0x17);
    LCD_WR_DATA(0x1A);
    LCD_WR_DATA(0x04);
    LCD_WR_DATA(0x0E);
    LCD_WR_DATA(0x06);
    LCD_WR_DATA(0x2F);
    LCD_WR_DATA(0x45);
    LCD_WR_DATA(0x43);
    LCD_WR_DATA(0x02);
    LCD_WR_DATA(0x0A);
    LCD_WR_DATA(0x09);
    LCD_WR_DATA(0x32);
    LCD_WR_DATA(0x36);
    LCD_WR_DATA(0x0F);

    /* Sleep Out11h */
    LCD_WR_REG(0x11);

    delay_ms(100);

    LCD_DisplayOn();

    // 横屏
    // TODO:需同步更改lcd长宽参数和触摸反馈选项
    // LCD_Scan_Dir(D2U_L2R);

    //点亮背光
    GPIO_SetBit(STAR_GPIO0, GPIO_Pin_6);

    LCD_Clear(WHITE);
}
//清屏函数
//color:要清屏的填充色
void LCD_Clear(uint32_t color)
{
    uint32_t index = 0;
    uint32_t totalpoint = LCD_W * LCD_H;
    LCD_Set_Window(0, 0, LCD_W - 1, LCD_H - 1);
    LCD_WriteRAM_Prepare(); //开始写入GRAM
    for (index = 0;index < totalpoint;index++)
    {
        AHB_LCD->data_reg = color;
    }

}

//画线
//x1,y1:起点坐标
//x2,y2:终点坐标  
void LCD_DrawLine(uint16_t x1, uint16_t y1, uint16_t x2, uint16_t y2)
{
    uint16_t t;
    int xerr = 0, yerr = 0, delta_x, delta_y, distance;
    int incx, incy, uRow, uCol;
    delta_x = x2 - x1; //计算坐标增量 
    delta_y = y2 - y1;
    uRow = x1;
    uCol = y1;
    if (delta_x > 0)incx = 1; //设置单步方向 
    else if (delta_x == 0)incx = 0;//垂直线 
    else { incx = -1;delta_x = -delta_x; }
    if (delta_y > 0)incy = 1;
    else if (delta_y == 0)incy = 0;//水平线 
    else { incy = -1;delta_y = -delta_y; }
    if (delta_x > delta_y)distance = delta_x; //选取基本增量坐标轴 
    else distance = delta_y;
    for (t = 0;t <= distance + 1;t++)//画线输出 
    {
        LCD_DrawPoint_color((uint16_t)uRow, (uint16_t)uCol, POINT_COLOR);//画点 
        xerr += delta_x;
        yerr += delta_y;
        if (xerr > distance)
        {
            xerr -= distance;
            uRow += incx;
        }
        if (yerr > distance)
        {
            yerr -= distance;
            uCol += incy;
        }
    }
}
//画矩形	  
//(x1,y1),(x2,y2):矩形的对角坐标
void LCD_DrawRectangle(uint16_t x1, uint16_t y1, uint16_t x2, uint16_t y2)
{
    LCD_DrawLine(x1, y1, x2, y1);
    LCD_DrawLine(x1, y1, x1, y2);
    LCD_DrawLine(x1, y2, x2, y2);
    LCD_DrawLine(x2, y1, x2, y2);
}

//在指定位置画一个指定大小的圆
//(x,y):中心点
//r    :半径
void LCD_Draw_Circle(uint16_t x0, uint16_t y0, uint8_t r)
{
    int a, b;
    int di;
    a = 0;b = r;
    di = 3 - (r << 1);             //判断下个点位置的标志
    while (a <= b)
    {
        LCD_DrawPoint_color((uint16_t)(x0 + a), (uint16_t)(y0 - b), POINT_COLOR);
        LCD_DrawPoint_color((uint16_t)(x0 + b), (uint16_t)(y0 - a), POINT_COLOR);
        LCD_DrawPoint_color((uint16_t)(x0 + b), (uint16_t)(y0 + a), POINT_COLOR);
        LCD_DrawPoint_color((uint16_t)(x0 + a), (uint16_t)(y0 + b), POINT_COLOR);
        LCD_DrawPoint_color((uint16_t)(x0 - a), (uint16_t)(y0 + b), POINT_COLOR);
        LCD_DrawPoint_color((uint16_t)(x0 - b), (uint16_t)(y0 + a), POINT_COLOR);
        LCD_DrawPoint_color((uint16_t)(x0 - a), (uint16_t)(y0 - b), POINT_COLOR);
        LCD_DrawPoint_color((uint16_t)(x0 - b), (uint16_t)(y0 - a), POINT_COLOR);
        a++;
        //使用Bresenham算法画圆     
        if (di < 0)di += 4 * a + 6;
        else
        {
            di += 10 + 4 * (a - b);
            b--;
        }
    }
}

//在指定位置显示一个字符
//x,y:起始坐标
//num:要显示的字符:" "--->"~"
//size:字体大小 12/16/24/32
//mode:叠加方式(1)还是非叠加方式(0)
void LCD_ShowChar(uint16_t x, uint16_t y, uint8_t num, uint8_t mode)
{
    uint8_t temp, t1, t;
    uint16_t y0 = y;
    uint8_t size = 16;
    uint8_t csize = (size / 8 + ((size % 8) ? 1 : 0)) * (size / 2);		//得到字体一个字符对应点阵集所占的字节数	
    num = num - ' ';//得到偏移后的值（ASCII字库是从空格开始取模，所以-' '就是对应字符的字库）
    for (t = 0;t < csize;t++)
    {
        temp = asc2_1608[num][t];	//调用1608字体
        for (t1 = 0;t1 < 8;t1++)
        {
            if (temp & 0x80)LCD_DrawPoint_color(x, y, POINT_COLOR);
            else if (mode == 0)LCD_DrawPoint_color(x, y, BACK_COLOR);
            temp <<= 1;
            y++;
            if (y >= LCD_H)return;		//超区域了
            if ((y - y0) == size)
            {
                y = y0;
                x++;
                if (x >= LCD_W)return;	//超区域了
                break;
            }
        }
    }
}

//m^n函数
//返回值:m^n次方.
static uint32_t LCD_Pow(uint8_t m, uint8_t n)
{
    uint32_t result = 1;
    while (n--)result *= m;
    return result;
}

//显示数字,高位为0,则不显示
//x,y :起点坐标	 
//len :数字的位数
//size:字体大小
//color:颜色 
//num:数值(0~4294967295);	 
void LCD_ShowNum(uint16_t x, uint16_t y, uint32_t num, uint8_t len)
{
    uint8_t t, temp;
    uint8_t enshow = 0;
    uint8_t size = 16;
    for (t = 0;t < len;t++)
    {
        temp = (num / LCD_Pow(10, len - t - 1)) % 10;
        if (enshow == 0 && t < (len - 1))
        {
            if (temp == 0)
            {
                LCD_ShowChar(x + (size / 2) * t, y, ' ', 0);
                continue;
            }
            else enshow = 1;

        }
        LCD_ShowChar(x + (size / 2) * t, y, temp + '0', 0);
    }
}

//显示数字,高位为0,还是显示
//x,y:起点坐标
//num:数值(0~999999999);	 
//len:长度(即要显示的位数)
//size:字体大小
//mode:
//[7]:0,不填充;1,填充0.
//[6:1]:保留
//[0]:0,非叠加显示;1,叠加显示.
void LCD_ShowxNum(uint16_t x, uint16_t y, uint32_t num, uint8_t len, uint8_t mode)
{
    uint8_t t, temp;
    uint8_t enshow = 0;
    uint8_t size = 16;
    for (t = 0;t < len;t++)
    {
        temp = (num / LCD_Pow(10, len - t - 1)) % 10;
        if (enshow == 0 && t < (len - 1))
        {
            if (temp == 0)
            {
                if (mode & 0X80)LCD_ShowChar(x + (size / 2) * t, y, '0', mode & 0X01);
                else LCD_ShowChar(x + (size / 2) * t, y, ' ', mode & 0X01);
                continue;
            }
            else enshow = 1;

        }
        LCD_ShowChar(x + (size / 2) * t, y, temp + '0', mode & 0X01);
    }
}

//显示字符串
//x,y:起点坐标
//width,height:区域大小  
//size:字体大小
//*p:字符串起始地址		  
void LCD_ShowString(uint16_t x, uint16_t y, uint16_t width, uint16_t height, uint8_t* p)
{
    uint16_t x0 = x;
    width += x;
    height += y;
    uint16_t size = 16;
    while ((*p <= '~') && (*p >= ' '))//判断是不是非法字符!
    {
        if (x >= width) { x = x0;y += size; }
        if (y >= height)break;//退出
        LCD_ShowChar(x, y, *p, 0);
        x += size / 2;
        p++;
    }
}
